## config/west.yml
```yaml
manifest:
  remotes:
    - name: zmkfirmware
      url-base: https://github.com/zmkfirmware
    - name: kjerstadius
      url-base: https://github.com/kjerstadius
  projects:
    - name: zmk
      remote: kjerstadius
      revision: refactor/layer-label
      import: app/west.yml
  self:
    path: config
```
