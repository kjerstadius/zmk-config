/*
* Copyright (c) 2020 The ZMK Contributors
*
* SPDX-License-Identifier: MIT
*/

#include "include/macros.dtsi"
#include "include/layer_ids.h"

#include <behaviors.dtsi>
#include <dt-bindings/zmk/bt.h>
#include <dt-bindings/zmk/ext_power.h>
#include <dt-bindings/zmk/keys.h>
#include <dt-bindings/zmk/outputs.h>
#include <dt-bindings/zmk/rgb.h>

#include "include/combos.dtsi"
#define CORE_COL_START_R0L 1
#define CORE_COL_START_R0R 6
#define CORE_COL_START_R1L 13
#define CORE_COL_START_R1R 18
#define CORE_COL_START_R2L 25
#define CORE_COL_START_R2R 34
#define CORE_COL_START_R3L 40
#define CORE_COL_START_R3R 45

#define LAYOUT_ADAPTER(K00, K01, K02, K03, K04, K05,                     K06, K07, K08, K09, K0A, K0B, \
                       K10, K11, K12, K13, K14, K15,                     K16, K17, K18, K19, K1A, K1B, \
                       K20, K21, K22, K23, K24, K25, K26, K27, K28, K29, K2A, K2B, K2C, K2D, K2E, K2F, \
                                      K30, K31, K32, K33, K34, K35, K36, K37, K38, K39)                \
                       K00  K01  K02  K03  K04  K05                      K06  K07  K08  K09  K0A  K0B  \
                       K10  K11  K12  K13  K14  K15                      K16  K17  K18  K19  K1A  K1B  \
                       K20  K21  K22  K23  K24  K25  K26  K27  K28  K29  K2A  K2B  K2C  K2D  K2E  K2F  \
                                      K30  K31  K32  K33  K34  K35  K36  K37  K38  K39

# include "include/keymap_common.dtsi"

/* vim: set ft=dts: */
